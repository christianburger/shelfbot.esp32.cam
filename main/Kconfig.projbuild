## main/Kconfig.projbuild
```kconfig
menu "Wi-Fi Configuration"

    config WIFI_SSID_1
        string "Wi-Fi SSID #1"
        default ""
        help
            SSID of the first Wi-Fi network to connect to.
            Leave empty to skip.

    config WIFI_PASS_1
        string "Wi-Fi Password #1"
        default ""
        help
            Password for the first Wi-Fi network. Leave empty for open network.

    config WIFI_SSID_2
        string "Wi-Fi SSID #2"
        default ""
        help
            SSID of the second Wi-Fi network.

    config WIFI_PASS_2
        string "Wi-Fi Password #2"
        default ""

    config WIFI_SSID_3
        string "Wi-Fi SSID #3"
        default ""

    config WIFI_PASS_3
        string "Wi-Fi Password #3"
        default ""

    config WIFI_SSID_4
        string "Wi-Fi SSID #4"
        default ""

    config WIFI_PASS_4
        string "Wi-Fi Password #4"
        default ""

    config WIFI_RSSI_WARN_THRESHOLD
        int "RSSI warning threshold (dBm)"
        default -75
        range -100 -30
        help
            If RSSI drops below this value, the connection is considered degraded.
            More negative = weaker signal.

    config WIFI_RSSI_CRITICAL_THRESHOLD
        int "RSSI critical threshold (dBm)"
        default -85
        range -100 -30
        help
            If RSSI drops below this value, the manager will immediately scan for a better AP.

    config WIFI_DEGRADED_CONFIRM_N
        int "Number of consecutive degraded samples before switching"
        default 3
        range 1 10
        help
            How many consecutive RSSI readings below the warning threshold are required
            to trigger a scan for a better AP.

    config WIFI_MONITOR_INTERVAL_MS
        int "RSSI monitoring interval (ms)"
        default 5000
        range 1000 60000
        help
            How often to check the RSSI of the current connection while connected.

    config WIFI_RETRIES_PER_NETWORK
        int "Connection attempts per network"
        default 3
        range 1 10
        help
            How many times to try connecting to a specific AP before giving up.

    config WIFI_INTER_CYCLE_DELAY_S
        int "Delay between scan cycles when no AP is visible (seconds)"
        default 10
        range 1 120
        help
            How long to wait when no known AP is found before scanning again.

endmenu
```
